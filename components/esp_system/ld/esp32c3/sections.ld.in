/*
 * SPDX-FileCopyrightText: 2021 Espressif Systems (Shanghai) CO LTD
 *
 * SPDX-License-Identifier: Apache-2.0
 */

/* Default entry point */
ENTRY(call_start_cpu0);

SECTIONS
{
#include "ld.rtc.sections"

#include "ld.iram.sections"

#include "ld.dram.sections"

#if CONFIG_IDF_RTOS_RTTHREAD
  /* Use 16-byte alignment for the RISC-V stack ABI and RT-Thread RT_ALIGN_SIZE. */
  /* RT-Thread interrupt stack: vectors.S switches to it via __stack_end__ */
  .stack :
  {
      . = ALIGN(16);
      __STACKSIZE__ = CONFIG_IDF_RTTHREAD_INTERRUPT_STACK_SIZE;
      __stack_start__ = .;
      *(.stack*)
      . = ALIGN(16);
      . += __STACKSIZE__;
      __stack_cpu0 = .;
      __stack_end__ = .;
  } > dram_seg
  PROVIDE( __rt_rvstack = __stack_end__);

  /* RT-Thread heap */
  .heap :
  {
      . = ALIGN(16);
      __HEAPSIZE__ = CONFIG_IDF_RTTHREAD_HEAP_SIZE;
      __heap_start__ = .;
      . += __HEAPSIZE__;
      __heap_end__ = .;
  } > dram_seg
#endif

#include "ld.flash.sections"

#if CONFIG_IDF_RTOS_RTTHREAD
  /* RT-Thread finsh shell symbol table and auto-initialization function table */
  .flash.rt_thread :
  {
    /* finsh shell symbol table */
    . = ALIGN(8);
    __fsymtab_start = .;
    KEEP(*(FSymTab))
    __fsymtab_end = .;
    . = ALIGN(8);
    __vsymtab_start = .;
    KEEP(*(VSymTab))
    __vsymtab_end = .;
    . = ALIGN(8);

    /* RT-Thread auto-initialization function table */
    . = ALIGN(4);
    __rt_init_start = .;
    KEEP(*(SORT(.rti_fn*)))
    __rt_init_end = .;
    . = ALIGN(4);
  } > flash_rodata_seg
#endif

#include "ld.heap.sections"

#include "ld.debug.sections"
#include "ld.discard.sections"
}
